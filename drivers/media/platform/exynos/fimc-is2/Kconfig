## drivers/media/platform/exynos/fimc-is2/Kconfig
```kconfig
config VIDEO_EXYNOS_FIMC_IS2
	bool "Exynos FIMC-IS2 (Image Subsystem) driver"
	depends on VIDEO_EXYNOS
	select MEDIA_EXYNOS
	select EXYNOS_FIMC_IS
	default n
	help
	  This is a v4l2 driver for exynos FIMC-IS device.

config FIMC_IS_J4CAM
	tristate "J4 camera V4L2 front-end (standard /dev/videoN capture nodes)"
	depends on VIDEO_EXYNOS_FIMC_IS2 && VIDEO_V4L2
	select VIDEOBUF2_VMALLOC
	default VIDEO_EXYNOS_FIMC_IS2
	help
	  Exposes the rear and front camera of the Galaxy J4 as two ordinary
	  V4L2 capture devices (NV12, upright, one camera at a time) on top of the
	  low-level FIMC-IS2 nodes, which are otherwise closed to userspace.
	  Camera apps (Cheese, GStreamer, browsers) then work without any daemon,
	  udev rule or vendor HAL. Say Y; M is only useful while developing.

config CAMERA_USE_SOC_SENSOR
        bool "Use soc camera sensor"
        depends on VIDEO_EXYNOS_FIMC_IS2
        default n
        help
           Use to build SOC camera sensor

source "drivers/media/platform/exynos/fimc-is2/ischain/Kconfig"
source "drivers/media/platform/exynos/fimc-is2/sensor/Kconfig"

#menu depth1
menu "Base Feature Setting"
	depends on EXYNOS_FIMC_IS

source "drivers/media/platform/exynos/fimc-is2/hardware/Kconfig"
endmenu

source "drivers/media/platform/exynos/fimc-is2/vendor/Kconfig"
```
